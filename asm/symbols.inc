; If you need pointer access reserve R26 to R31 for that purpose.
; 16-bit-counter are best located R25:R24.
; If you need to read from the program memory, e.g. fixed tables, reserve Z (R31:R30) and R0 for that purpose.
; If you plan to have access to single bits within certain registers (e.g. for testing flags), use R16 to R23 for that purpose
; Фьюзы = 0x7A
; Делитель частоты 64
.EQU	CLKDIV64	=(0<<CS02)+(1<<CS01)+(1<<CS00) ; CLKio/64
; Количество тиков таймера
.EQU	TMTICKS		=150	; При CLKio=9.6МГц: 9.6*10^6/(64*150)=1*10^3=1КГц

.EQU	I2C_RTC_ADDR = 0xd0	; Адрес чипа часов на шине RTC

.DEF	REG_IND_ST_PTR = R6	; Регистр состояния индикации. Содержит указатель на один из элементов ST<X>_LED_STATES
.DEF	REG_IND_STM_PTR= R7	; Регистр содержит указатель на конкретный режим - текущий элемент в списке индикации (ST<X>_LED_STATES)

							; Регистр состояния программных таймеров:
.DEF	REG_SW_TM_STATE = R8; единица в соответствующем бите маркирует активный таймер
.EQU	COUNT_TIMERS = 4	; количество программных таймеров
.EQU	IND_TM_NUM = 0		; номер таймера, обслуживающего индикатор (светодиод)
.EQU	INP_SHORT_TM_NUM = 1; номер таймера, обслуживающего кнопку (короткое нажатие)
.EQU	INP_LONG_TM_NUM = 2	; номер таймера, обслуживающего кнопку (длинное нажатие)
.EQU	RTC_TM_NUM = 3		; номер таймера, обслуживающего часы

							; Регистр для подсчета тиков аппаратного таймера:
							; в прерывании таймера увеличивается значение
							; далее в процедуре обработки таймеров на это
.DEF	REG_HW_TM_TICKS = R9; значение уменьшается значение в программных таймерах
								
.EQU	SHORT_PRESS_TIME = 20			; таймер для отсчета короткого нажатия = 20 мс
.EQU	LONG_PRESS_TIME_HIGH = 0x01		; таймер для отсчета длинного нажатия = 500 мс
.EQU	LONG_PRESS_TIME_LOW =	0xF4
.EQU	RTC_TIMER_HIGH = 0x27			; таймер опроса RTC = 10 сек
.EQU	RTC_TIMER_LOW = 0x10

.DEF	REG_IND_STATE = R11	; Регистр состояния индикатора:
.DEF	REG_TMP3 = R13	; Регистр состояния кнопки
.DEF	REG_TMP_TM_NUM = R16
.DEF	REG_TMP = R17		; Регистры для временных операций
.DEF	REG_TMP1 = R18
.DEF	REG_TMP2 = R19
; Глобальный регистр флагов
.DEF	REG_FLAGS = R20
; Биты:
; 0 - короткое нажатие кнопки
.EQU	SHORT_PRESS_BIT = 0
; 1 - длинное нажатие кнопки
.EQU	LONG_PRESS_BIT = 1
; 2 - ручной режим
.EQU	MANUAL_MODE_BIT = 2
; 3 - нагрузка включена
.EQU	LOAD_ON_BIT = 3
; 4 - время "день" по RTC
.EQU	RTC_ON_BIT = 4
; 5 - необходимо сменить режим индикации
.EQU	IND_ST_CH_BIT = 5
; 6 - запустить установку часов
.EQU	RTC_SET_BIT = 6
; 7 - время выключения не установлено
.EQU	RTC_OFF_UNDEF = 7

; Локальный (вспомогательный) регистр флагов
.DEF	REG_LOCAL_FLAGS = R25
; Биты:
; 0 - Внутренний флаг короткого нажатия - устанавливается по таймеру короткого нажатия
; и держится взведенным до тех пор, пока кнопку не отпустили. Либо пока не сработал
; таймер длинного нажатия.
.EQU	L_SHORT_PRESS_BIT = 0
; 1 - Внутренний флаг длинного нажатия - устанавливается по таймеру длинного нажатия
; и держится взведенным до тех пор, пока кнопку не отпустили
.EQU	L_LONG_PRESS_BIT = 1

.EQU	RTC_BUF_LENGTH = 3		; длина буфера для хранения данных из ОЗУ RTC
.EQU	RTC_CONTROL_LEHGTH = 1	; размер управляющего регистра RTC
.EQU	RTC_CONTROL_ADDR = 0x7	; адрес управляющего регистра в RTC
.EQU	RTC_ALARM_ADDR = 0x8	; адрес будильника в ОЗУ RTC
.EQU	RTC_CURR_ADDR = 0x0		; адрес текущего времени в RTC
.EQU	RTC_UNSET_MARK = 0xFF	; если получаю это значение из будильника RTC, считаю, что он не установлен
.EQU	RTC_CONTROL_BIT = 4		; номер бита управления индикацией через RTC

; Индикация:
; 1. Автоматический режим
; 1.1. Авто режим включено
; 1.1.1. Время выключения не установлено
; Индикатор вспыхивает 3 раза, после чего пауза
.EQU	ST_IND_A_ON_UNDEF = 0
; 1.1.2. Время выключения установлено
; Индикатор не горит
.EQU	ST_IND_A_ON_DEF = 1
; 1.2. Авто режим выключено
; 1.2.1. Время выключения не установлено А ТАКОГО РЕЖИМА НЕ МОЖЕТ БЫТЬ - В АВТОРЕЖИМЕ, ЕСЛИ ВРЕМЯ ВЫКЛЮЧЕНИЯ НЕ УСТАНОВЛЕНО, ВСЕГДА ВКЛЮЧЕНО
; Индикатор вспыхивает 4 раза в секунду
.EQU	ST_IND_A_OFF_UNDEF = 2
; 1.2.2. Время выключения установлено
; Индикатор горит постоянно
.EQU	ST_IND_A_OFF_DEF = 3
; 2. Ручной режим
; 2.1. Ручной режим включено
; Индикатор вспыхивает 1 раз в секунду
.EQU	ST_IND_M_ON = 4
; 2.2. Ручной режим выключено
; Индикатор вспыхивает 1 раз в 4 секунды
.EQU	ST_IND_M_OFF = 5
